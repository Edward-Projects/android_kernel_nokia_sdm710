&qupv3_se9_i2c {
	status = "okay";
	pinctrl-names = "default", "sleep";
	pinctrl-0 = <&qupv3_se9_i2c_active>;
	pinctrl-1 = <&qupv3_se9_i2c_sleep>;
	qcom,clk-freq-out = <400000>;
	qcom,clk-freq-in  = <19200000>;

	/* Novatek device tree node */
	novatek@62 {
		compatible = "novatek,NVT-ts";
		reg = <0x62>;
		status = "ok";
		novatek,reset-gpio = <&tlmm 99 0x00>;
		novatek,irq-gpio = <&tlmm 125 0x00>;

		/* MP */
		novatek,mp-support-dt;

		novatek-mp-criteria-5107@0 {	
			#address-cells = <1>;
			#size-cells = <0>;
			compatible = "novatek-mp-criteria-5107";

			/* MP Config */
			IC_X_CFG_SIZE = <18>;
			IC_Y_CFG_SIZE = <36>;
			IC_KEY_CFG_SIZE = <4>;
			X_Channel = <18>;
			Y_Channel = <36>;
			AIN_X = <0 1 2 3 4 5 6 7 8 9 10 11 12 13 14 15 16 17>;
			AIN_Y = <0 1 2 3 4 5 6 7 8 9 10 11 12 13 14 15 16 17 18 19 20 21 22 23 24 25 26 27 28 29 30 31 32 33 34 35>;
			AIN_KEY = <0 1 2 0xFF>;

			/* MP Criteria */
			PS_Config_Lmt_Short_Rawdata_P = <
				14008 14008 14008 14008 14008 14008 14008 14008 14008 14008 14008 14008 14008 14008 14008 14008 14008 14008
				14008 14008 14008 14008 14008 14008 14008 14008 14008 14008 14008 14008 14008 14008 14008 14008 14008 14008
				14008 14008 14008 14008 14008 14008 14008 14008 14008 14008 14008 14008 14008 14008 14008 14008 14008 14008
				14008 14008 14008 14008 14008 14008 14008 14008 14008 14008 14008 14008 14008 14008 14008 14008 14008 14008
				14008 14008 14008 14008 14008 14008 14008 14008 14008 14008 14008 14008 14008 14008 14008 14008 14008 14008
				14008 14008 14008 14008 14008 14008 14008 14008 14008 14008 14008 14008 14008 14008 14008 14008 14008 14008
				14008 14008 14008 14008 14008 14008 14008 14008 14008 14008 14008 14008 14008 14008 14008 14008 14008 14008
				14008 14008 14008 14008 14008 14008 14008 14008 14008 14008 14008 14008 14008 14008 14008 14008 14008 14008
				14008 14008 14008 14008 14008 14008 14008 14008 14008 14008 14008 14008 14008 14008 14008 14008 14008 14008
				14008 14008 14008 14008 14008 14008 14008 14008 14008 14008 14008 14008 14008 14008 14008 14008 14008 14008
				14008 14008 14008 14008 14008 14008 14008 14008 14008 14008 14008 14008 14008 14008 14008 14008 14008 14008
				14008 14008 14008 14008 14008 14008 14008 14008 14008 14008 14008 14008 14008 14008 14008 14008 14008 14008
				14008 14008 14008 14008 14008 14008 14008 14008 14008 14008 14008 14008 14008 14008 14008 14008 14008 14008
				14008 14008 14008 14008 14008 14008 14008 14008 14008 14008 14008 14008 14008 14008 14008 14008 14008 14008
				14008 14008 14008 14008 14008 14008 14008 14008 14008 14008 14008 14008 14008 14008 14008 14008 14008 14008
				14008 14008 14008 14008 14008 14008 14008 14008 14008 14008 14008 14008 14008 14008 14008 14008 14008 14008
				14008 14008 14008 14008 14008 14008 14008 14008 14008 14008 14008 14008 14008 14008 14008 14008 14008 14008
				14008 14008 14008 14008 14008 14008 14008 14008 14008 14008 14008 14008 14008 14008 14008 14008 14008 14008
				14008 14008 14008 14008 14008 14008 14008 14008 14008 14008 14008 14008 14008 14008 14008 14008 14008 14008
				14008 14008 14008 14008 14008 14008 14008 14008 14008 14008 14008 14008 14008 14008 14008 14008 14008 14008
				14008 14008 14008 14008 14008 14008 14008 14008 14008 14008 14008 14008 14008 14008 14008 14008 14008 14008
				14008 14008 14008 14008 14008 14008 14008 14008 14008 14008 14008 14008 14008 14008 14008 14008 14008 14008
				14008 14008 14008 14008 14008 14008 14008 14008 14008 14008 14008 14008 14008 14008 14008 14008 14008 14008
				14008 14008 14008 14008 14008 14008 14008 14008 14008 14008 14008 14008 14008 14008 14008 14008 14008 14008
				14008 14008 14008 14008 14008 14008 14008 14008 14008 14008 14008 14008 14008 14008 14008 14008 14008 14008
				14008 14008 14008 14008 14008 14008 14008 14008 14008 14008 14008 14008 14008 14008 14008 14008 14008 14008
				14008 14008 14008 14008 14008 14008 14008 14008 14008 14008 14008 14008 14008 14008 14008 14008 14008 14008
				14008 14008 14008 14008 14008 14008 14008 14008 14008 14008 14008 14008 14008 14008 14008 14008 14008 14008
				14008 14008 14008 14008 14008 14008 14008 14008 14008 14008 14008 14008 14008 14008 14008 14008 14008 14008
				14008 14008 14008 14008 14008 14008 14008 14008 14008 14008 14008 14008 14008 14008 14008 14008 14008 14008
				14008 14008 14008 14008 14008 14008 14008 14008 14008 14008 14008 14008 14008 14008 14008 14008 14008 14008
				14008 14008 14008 14008 14008 14008 14008 14008 14008 14008 14008 14008 14008 14008 14008 14008 14008 14008
				14008 14008 14008 14008 14008 14008 14008 14008 14008 14008 14008 14008 14008 14008 14008 14008 14008 14008
				14008 14008 14008 14008 14008 14008 14008 14008 14008 14008 14008 14008 14008 14008 14008 14008 14008 14008
				14008 14008 14008 14008 14008 14008 14008 14008 14008 14008 14008 14008 14008 14008 14008 14008 14008 14008
				14008 14008 14008 14008 14008 14008 14008 14008 14008 14008 14008 14008 14008 14008 14008 14008 14008 14008
				20000 20000 20000>;

			PS_Config_Lmt_Short_Rawdata_N = <
				11376 11376 11376 11376 11376 11376 11376 11376 11376 11376 11376 11376 11376 11376 11376 11376 11376 11376
				11376 11376 11376 11376 11376 11376 11376 11376 11376 11376 11376 11376 11376 11376 11376 11376 11376 11376
				11376 11376 11376 11376 11376 11376 11376 11376 11376 11376 11376 11376 11376 11376 11376 11376 11376 11376
				11376 11376 11376 11376 11376 11376 11376 11376 11376 11376 11376 11376 11376 11376 11376 11376 11376 11376
				11376 11376 11376 11376 11376 11376 11376 11376 11376 11376 11376 11376 11376 11376 11376 11376 11376 11376
				11376 11376 11376 11376 11376 11376 11376 11376 11376 11376 11376 11376 11376 11376 11376 11376 11376 11376
				11376 11376 11376 11376 11376 11376 11376 11376 11376 11376 11376 11376 11376 11376 11376 11376 11376 11376
				11376 11376 11376 11376 11376 11376 11376 11376 11376 11376 11376 11376 11376 11376 11376 11376 11376 11376
				11376 11376 11376 11376 11376 11376 11376 11376 11376 11376 11376 11376 11376 11376 11376 11376 11376 11376
				11376 11376 11376 11376 11376 11376 11376 11376 11376 11376 11376 11376 11376 11376 11376 11376 11376 11376
				11376 11376 11376 11376 11376 11376 11376 11376 11376 11376 11376 11376 11376 11376 11376 11376 11376 11376
				11376 11376 11376 11376 11376 11376 11376 11376 11376 11376 11376 11376 11376 11376 11376 11376 11376 11376
				11376 11376 11376 11376 11376 11376 11376 11376 11376 11376 11376 11376 11376 11376 11376 11376 11376 11376
				11376 11376 11376 11376 11376 11376 11376 11376 11376 11376 11376 11376 11376 11376 11376 11376 11376 11376
				11376 11376 11376 11376 11376 11376 11376 11376 11376 11376 11376 11376 11376 11376 11376 11376 11376 11376
				11376 11376 11376 11376 11376 11376 11376 11376 11376 11376 11376 11376 11376 11376 11376 11376 11376 11376
				11376 11376 11376 11376 11376 11376 11376 11376 11376 11376 11376 11376 11376 11376 11376 11376 11376 11376
				11376 11376 11376 11376 11376 11376 11376 11376 11376 11376 11376 11376 11376 11376 11376 11376 11376 11376
				11376 11376 11376 11376 11376 11376 11376 11376 11376 11376 11376 11376 11376 11376 11376 11376 11376 11376
				11376 11376 11376 11376 11376 11376 11376 11376 11376 11376 11376 11376 11376 11376 11376 11376 11376 11376
				11376 11376 11376 11376 11376 11376 11376 11376 11376 11376 11376 11376 11376 11376 11376 11376 11376 11376
				11376 11376 11376 11376 11376 11376 11376 11376 11376 11376 11376 11376 11376 11376 11376 11376 11376 11376
				11376 11376 11376 11376 11376 11376 11376 11376 11376 11376 11376 11376 11376 11376 11376 11376 11376 11376
				11376 11376 11376 11376 11376 11376 11376 11376 11376 11376 11376 11376 11376 11376 11376 11376 11376 11376
				11376 11376 11376 11376 11376 11376 11376 11376 11376 11376 11376 11376 11376 11376 11376 11376 11376 11376
				11376 11376 11376 11376 11376 11376 11376 11376 11376 11376 11376 11376 11376 11376 11376 11376 11376 11376
				11376 11376 11376 11376 11376 11376 11376 11376 11376 11376 11376 11376 11376 11376 11376 11376 11376 11376
				11376 11376 11376 11376 11376 11376 11376 11376 11376 11376 11376 11376 11376 11376 11376 11376 11376 11376
				11376 11376 11376 11376 11376 11376 11376 11376 11376 11376 11376 11376 11376 11376 11376 11376 11376 11376
				11376 11376 11376 11376 11376 11376 11376 11376 11376 11376 11376 11376 11376 11376 11376 11376 11376 11376
				11376 11376 11376 11376 11376 11376 11376 11376 11376 11376 11376 11376 11376 11376 11376 11376 11376 11376
				11376 11376 11376 11376 11376 11376 11376 11376 11376 11376 11376 11376 11376 11376 11376 11376 11376 11376
				11376 11376 11376 11376 11376 11376 11376 11376 11376 11376 11376 11376 11376 11376 11376 11376 11376 11376
				11376 11376 11376 11376 11376 11376 11376 11376 11376 11376 11376 11376 11376 11376 11376 11376 11376 11376
				11376 11376 11376 11376 11376 11376 11376 11376 11376 11376 11376 11376 11376 11376 11376 11376 11376 11376
				11376 11376 11376 11376 11376 11376 11376 11376 11376 11376 11376 11376 11376 11376 11376 11376 11376 11376
				11550 11550 11550>;

			PS_Config_Lmt_Short_Diff_P = <
				6300 6300 6300 6300 6300 6300 6300 6300 6300 6300 6300 6300 6300 6300 6300 6300 6300 6300
				6300 6300 6300>;

			PS_Config_Lmt_Short_Diff_N = <
				0 0 0 0 0 0 0 0 0 0 0 0 0 0 0 0 0 0
				0 0 0>;

			PS_Config_Lmt_Short_Base_P = <
				2000 2000 2000 2000 2000 2000 2000 2000 2000 2000 2000 2000 2000 2000 2000 2000 2000 2000
				2000 2000 2000>;

			PS_Config_Lmt_Short_Base_N = <
				(-2000) (-2000) (-2000) (-2000) (-2000) (-2000) (-2000) (-2000) (-2000) (-2000) (-2000) (-2000) (-2000) (-2000) (-2000) (-2000) (-2000) (-2000)
				(-2000) (-2000) (-2000)>;

			PS_Config_Lmt_Open_Rawdata_P = <
				65535 4399 4778 4715 4648 65535 65535 65535 65535 65535 65535 65535 65535 4662 4731 4780 4374 65535
				3315 3335 3333 3342 3293 2701 2646 2643 2639 2654 2657 2657 2710 3312 3370 3359 3354 3317
				3108 3108 3105 3109 3107 3105 3104 3101 3098 3118 3118 3121 3122 3125 3129 3125 3125 3114
				3121 3111 3108 3114 3109 3107 3105 3101 3101 3116 3116 3119 3121 3123 3129 3125 3125 3122
				3118 3102 3101 3104 3100 3097 3097 3094 3091 3112 3111 3115 3115 3119 3125 3122 3122 3128
				3129 3108 3107 3108 3105 3101 3100 3097 3097 3112 3112 3115 3116 3119 3126 3125 3125 3137
				3128 3101 3097 3100 3094 3091 3090 3087 3087 3115 3112 3116 3118 3122 3128 3126 3126 3146
				3136 3101 3100 3101 3097 3093 3091 3087 3088 3105 3102 3108 3108 3111 3118 3118 3118 3142
				3136 3097 3095 3095 3091 3088 3087 3081 3083 3088 3086 3090 3090 3094 3101 3101 3101 3129
				3066 3021 3018 3020 3014 3010 3010 3004 3004 3003 3000 3004 3004 3009 3016 3017 3020 3053
				3135 3087 3086 3086 3080 3077 3076 3073 3072 3077 3073 3076 3076 3080 3086 3090 3090 3125
				3123 3073 3072 3073 3066 3063 3063 3060 3059 3079 3072 3074 3074 3079 3086 3088 3090 3128
				3123 3069 3067 3066 3060 3058 3058 3056 3055 3070 3065 3066 3066 3070 3076 3081 3083 3128
				3122 3132 3063 3062 3056 3052 3052 3053 3049 3052 3045 3048 3048 3051 3058 3063 3135 3114
				3102 3112 3111 3041 3032 3030 3030 3030 3025 3052 3044 3048 3046 3049 3056 3133 3135 3118
				3101 3111 3109 3109 3030 3028 3030 3028 3024 3030 3024 3025 3024 3024 3107 3111 3114 3098
				3095 3102 3102 3101 3018 3020 3021 3024 3016 3031 3028 3025 3023 3021 3105 3111 3115 3102
				2996 3003 3002 3000 2916 2919 2919 2918 2913 2922 2913 2916 2913 2911 2997 3002 3007 2996
				3066 3067 3066 3066 2981 2983 2985 2982 2978 2992 2983 2988 2985 2981 3066 3070 3076 3065
				3052 3048 3046 3046 2960 2964 2965 2962 2964 2989 2979 2983 2981 2976 3063 3067 3073 3063
				3041 3037 3034 3034 2947 2951 2953 2950 2953 2958 2950 2953 2951 2946 3032 3037 3042 3034
				3035 3030 3028 3028 2941 2947 2948 2946 2946 2946 2936 2940 2939 2933 3021 3024 3030 3023
				3010 3003 3000 3000 2912 2919 2920 2919 2918 2926 2918 2922 2919 2913 3000 3004 3010 3003
				2996 2985 2982 2982 2894 2901 2904 2902 2899 2912 2904 2909 2906 2899 2988 2992 2999 2995
				2792 2779 2778 2779 2733 2741 2744 2744 2740 2747 2740 2743 2740 2730 2778 2780 2786 2787
				2698 2685 2684 2684 2638 2646 2650 2650 2643 2639 2636 2639 2635 2626 2673 2677 2682 2682
				2751 2737 2736 2736 2691 2698 2702 2703 2695 2708 2705 2705 2701 2692 2738 2743 2748 2750
				2727 2713 2713 2713 2667 2675 2678 2681 2671 2677 2681 2684 2680 2671 2717 2722 2727 2729
				2715 2699 2696 2696 2652 2660 2664 2660 2654 2652 2656 2659 2654 2645 2692 2696 2702 2708
				2684 2668 2667 2667 2621 2629 2633 2631 2625 2618 2622 2626 2621 2614 2660 2664 2668 2677
				2660 2645 2642 2640 2594 2603 2607 2605 2598 2600 2604 2608 2603 2594 2640 2645 2649 2656
				2643 2626 2624 2624 2577 2586 2591 2589 2580 2579 2584 2589 2583 2575 2621 2625 2629 2638
				2619 2603 2600 2600 2554 2561 2568 2565 2556 2555 2561 2566 2558 2549 2596 2600 2604 2612
				2596 2580 2579 2577 2531 2540 2547 2544 2534 2521 2528 2534 2526 2517 2563 2566 2570 2577
				2141 2681 2680 2681 2635 2642 2650 2646 2638 2645 2652 2659 2649 2642 2688 2689 2695 2146
				2129 2671 2729 2738 2692 2687 2694 2692 2684 2682 2688 2689 2680 2684 2731 2723 2671 2128
				13000 13000 13000>;

			PS_Config_Lmt_Open_Rawdata_N = <
				0 1885 2048 2021 1992 0 0 0 0 0 0 0 0 1998 2027 2048 1874 0
				1421 1429 1429 1432 1411 1157 1134 1133 1131 1138 1139 1139 1162 1420 1444 1439 1438 1421
				1332 1332 1331 1333 1331 1331 1330 1329 1328 1336 1336 1337 1338 1339 1341 1339 1339 1334
				1337 1333 1332 1334 1333 1331 1331 1329 1329 1336 1336 1337 1337 1339 1341 1339 1339 1338
				1336 1330 1329 1330 1328 1327 1327 1326 1325 1334 1333 1335 1335 1337 1339 1338 1338 1340
				1341 1332 1331 1332 1331 1329 1328 1327 1327 1334 1334 1335 1336 1337 1340 1339 1339 1345
				1340 1329 1327 1328 1326 1325 1324 1323 1323 1335 1334 1336 1336 1338 1340 1340 1340 1348
				1344 1329 1328 1329 1327 1325 1325 1323 1324 1331 1330 1332 1332 1333 1336 1336 1336 1346
				1344 1327 1327 1327 1325 1324 1323 1321 1321 1324 1322 1324 1324 1326 1329 1329 1329 1341
				1314 1295 1294 1294 1292 1290 1290 1288 1288 1287 1286 1288 1288 1289 1292 1293 1294 1309
				1343 1323 1322 1322 1320 1319 1318 1317 1316 1319 1317 1318 1318 1320 1322 1324 1324 1339
				1339 1317 1316 1317 1314 1313 1313 1312 1311 1319 1316 1318 1318 1319 1322 1324 1324 1340
				1339 1315 1315 1314 1312 1310 1310 1310 1309 1316 1313 1314 1314 1316 1318 1321 1321 1340
				1338 1342 1313 1312 1310 1308 1308 1309 1307 1308 1305 1306 1306 1307 1310 1313 1343 1334
				1330 1334 1333 1303 1300 1298 1298 1298 1297 1308 1304 1306 1306 1307 1310 1343 1343 1336
				1329 1333 1333 1333 1298 1298 1298 1298 1296 1298 1296 1297 1296 1296 1331 1333 1334 1328
				1327 1330 1330 1329 1294 1294 1295 1296 1292 1299 1298 1297 1295 1295 1331 1333 1335 1330
				1284 1287 1286 1286 1250 1251 1251 1250 1249 1252 1249 1250 1249 1247 1285 1286 1289 1284
				1314 1315 1314 1314 1277 1279 1279 1278 1276 1282 1279 1280 1279 1277 1314 1316 1318 1313
				1308 1306 1306 1306 1268 1270 1271 1270 1270 1281 1277 1279 1277 1276 1313 1315 1317 1313
				1303 1301 1300 1300 1263 1265 1265 1264 1265 1268 1264 1265 1265 1262 1300 1301 1304 1300
				1301 1298 1298 1298 1261 1263 1264 1262 1262 1262 1258 1260 1259 1257 1295 1296 1298 1295
				1290 1287 1286 1286 1248 1251 1252 1251 1250 1254 1250 1252 1251 1249 1286 1288 1290 1287
				1284 1279 1278 1278 1240 1243 1244 1244 1243 1248 1244 1247 1246 1243 1280 1282 1285 1283
				1196 1191 1190 1191 1171 1175 1176 1176 1174 1177 1174 1175 1174 1170 1190 1192 1194 1195
				1156 1151 1150 1150 1130 1134 1136 1136 1133 1131 1130 1131 1129 1126 1145 1147 1150 1150
				1179 1173 1172 1172 1153 1156 1158 1159 1155 1160 1159 1159 1157 1154 1174 1175 1178 1178
				1169 1163 1163 1163 1143 1147 1148 1149 1145 1147 1149 1150 1148 1145 1165 1166 1169 1169
				1163 1157 1156 1156 1136 1140 1142 1140 1138 1136 1138 1139 1138 1133 1154 1156 1158 1160
				1150 1144 1143 1143 1123 1127 1129 1127 1125 1122 1124 1126 1123 1120 1140 1142 1144 1147
				1140 1133 1132 1132 1112 1115 1117 1117 1114 1114 1116 1118 1115 1112 1132 1133 1135 1138
				1133 1126 1124 1124 1105 1108 1111 1109 1106 1105 1108 1109 1107 1103 1123 1125 1127 1130
				1123 1115 1114 1114 1094 1097 1100 1099 1096 1095 1097 1100 1096 1093 1112 1114 1116 1120
				1112 1106 1105 1105 1085 1088 1091 1090 1086 1081 1084 1086 1082 1079 1099 1100 1102 1105
				917 1149 1148 1149 1129 1132 1136 1134 1130 1133 1136 1139 1135 1132 1152 1153 1155 920
				913 1145 1169 1174 1154 1151 1154 1154 1150 1150 1152 1153 1148 1150 1171 1167 1145 912
				6500 6500 6500>;

			PS_Config_Lmt_FW_Rawdata_P = <
				65535 1700 1700 1700 1700 65535 65535 65535 65535 65535 65535 65535 65535 1700 1700 1700 1700 65535
				1700 1700 1700 1700 1700 1700 1700 1700 1700 1700 1700 1700 1700 1700 1700 1700 1700 1700
				1700 1700 1700 1700 1700 1700 1700 1700 1700 1700 1700 1700 1700 1700 1700 1700 1700 1700
				1700 1700 1700 1700 1700 1700 1700 1700 1700 1700 1700 1700 1700 1700 1700 1700 1700 1700
				1700 1700 1700 1700 1700 1700 1700 1700 1700 1700 1700 1700 1700 1700 1700 1700 1700 1700
				1700 1700 1700 1700 1700 1700 1700 1700 1700 1700 1700 1700 1700 1700 1700 1700 1700 1700
				1700 1700 1700 1700 1700 1700 1700 1700 1700 1700 1700 1700 1700 1700 1700 1700 1700 1700
				1700 1700 1700 1700 1700 1700 1700 1700 1700 1700 1700 1700 1700 1700 1700 1700 1700 1700
				1700 1700 1700 1700 1700 1700 1700 1700 1700 1700 1700 1700 1700 1700 1700 1700 1700 1700
				1700 1700 1700 1700 1700 1700 1700 1700 1700 1700 1700 1700 1700 1700 1700 1700 1700 1700
				1700 1700 1700 1700 1700 1700 1700 1700 1700 1700 1700 1700 1700 1700 1700 1700 1700 1700
				1700 1700 1700 1700 1700 1700 1700 1700 1700 1700 1700 1700 1700 1700 1700 1700 1700 1700
				1700 1700 1700 1700 1700 1700 1700 1700 1700 1700 1700 1700 1700 1700 1700 1700 1700 1700
				1700 1700 1700 1700 1700 1700 1700 1700 1700 1700 1700 1700 1700 1700 1700 1700 1700 1700
				1700 1700 1700 1700 1700 1700 1700 1700 1700 1700 1700 1700 1700 1700 1700 1700 1700 1700
				1700 1700 1700 1700 1700 1700 1700 1700 1700 1700 1700 1700 1700 1700 1700 1700 1700 1700
				1700 1700 1700 1700 1700 1700 1700 1700 1700 1700 1700 1700 1700 1700 1700 1700 1700 1700
				1700 1700 1700 1700 1700 1700 1700 1700 1700 1700 1700 1700 1700 1700 1700 1700 1700 1700
				1700 1700 1700 1700 1700 1700 1700 1700 1700 1700 1700 1700 1700 1700 1700 1700 1700 1700
				1700 1700 1700 1700 1700 1700 1700 1700 1700 1700 1700 1700 1700 1700 1700 1700 1700 1700
				1700 1700 1700 1700 1700 1700 1700 1700 1700 1700 1700 1700 1700 1700 1700 1700 1700 1700
				1700 1700 1700 1700 1700 1700 1700 1700 1700 1700 1700 1700 1700 1700 1700 1700 1700 1700
				1700 1700 1700 1700 1700 1700 1700 1700 1700 1700 1700 1700 1700 1700 1700 1700 1700 1700
				1700 1700 1700 1700 1700 1700 1700 1700 1700 1700 1700 1700 1700 1700 1700 1700 1700 1700
				1700 1700 1700 1700 1700 1700 1700 1700 1700 1700 1700 1700 1700 1700 1700 1700 1700 1700
				1700 1700 1700 1700 1700 1700 1700 1700 1700 1700 1700 1700 1700 1700 1700 1700 1700 1700
				1700 1700 1700 1700 1700 1700 1700 1700 1700 1700 1700 1700 1700 1700 1700 1700 1700 1700
				1700 1700 1700 1700 1700 1700 1700 1700 1700 1700 1700 1700 1700 1700 1700 1700 1700 1700
				1700 1700 1700 1700 1700 1700 1700 1700 1700 1700 1700 1700 1700 1700 1700 1700 1700 1700
				1700 1700 1700 1700 1700 1700 1700 1700 1700 1700 1700 1700 1700 1700 1700 1700 1700 1700
				1700 1700 1700 1700 1700 1700 1700 1700 1700 1700 1700 1700 1700 1700 1700 1700 1700 1700
				1700 1700 1700 1700 1700 1700 1700 1700 1700 1700 1700 1700 1700 1700 1700 1700 1700 1700
				1700 1700 1700 1700 1700 1700 1700 1700 1700 1700 1700 1700 1700 1700 1700 1700 1700 1700
				1700 1700 1700 1700 1700 1700 1700 1700 1700 1700 1700 1700 1700 1700 1700 1700 1700 1700
				1700 1700 1700 1700 1700 1700 1700 1700 1700 1700 1700 1700 1700 1700 1700 1700 1700 1700
				1700 1700 1700 1700 1700 1700 1700 1700 1700 1700 1700 1700 1700 1700 1700 1700 1700 1700
				2000 2000 2000>;

			PS_Config_Lmt_FW_Rawdata_N = <
				0 700 700 700 700 0 0 0 0 0 0 0 0 700 700 700 700 0
				700 700 700 700 700 700 700 700 700 700 700 700 700 700 700 700 700 700
				700 700 700 700 700 700 700 700 700 700 700 700 700 700 700 700 700 700
				700 700 700 700 700 700 700 700 700 700 700 700 700 700 700 700 700 700
				700 700 700 700 700 700 700 700 700 700 700 700 700 700 700 700 700 700
				700 700 700 700 700 700 700 700 700 700 700 700 700 700 700 700 700 700
				700 700 700 700 700 700 700 700 700 700 700 700 700 700 700 700 700 700
				700 700 700 700 700 700 700 700 700 700 700 700 700 700 700 700 700 700
				700 700 700 700 700 700 700 700 700 700 700 700 700 700 700 700 700 700
				700 700 700 700 700 700 700 700 700 700 700 700 700 700 700 700 700 700
				700 700 700 700 700 700 700 700 700 700 700 700 700 700 700 700 700 700
				700 700 700 700 700 700 700 700 700 700 700 700 700 700 700 700 700 700
				700 700 700 700 700 700 700 700 700 700 700 700 700 700 700 700 700 700
				700 700 700 700 700 700 700 700 700 700 700 700 700 700 700 700 700 700
				700 700 700 700 700 700 700 700 700 700 700 700 700 700 700 700 700 700
				700 700 700 700 700 700 700 700 700 700 700 700 700 700 700 700 700 700
				700 700 700 700 700 700 700 700 700 700 700 700 700 700 700 700 700 700
				700 700 700 700 700 700 700 700 700 700 700 700 700 700 700 700 700 700
				700 700 700 700 700 700 700 700 700 700 700 700 700 700 700 700 700 700
				700 700 700 700 700 700 700 700 700 700 700 700 700 700 700 700 700 700
				700 700 700 700 700 700 700 700 700 700 700 700 700 700 700 700 700 700
				700 700 700 700 700 700 700 700 700 700 700 700 700 700 700 700 700 700
				700 700 700 700 700 700 700 700 700 700 700 700 700 700 700 700 700 700
				700 700 700 700 700 700 700 700 700 700 700 700 700 700 700 700 700 700
				700 700 700 700 700 700 700 700 700 700 700 700 700 700 700 700 700 700
				700 700 700 700 700 700 700 700 700 700 700 700 700 700 700 700 700 700
				700 700 700 700 700 700 700 700 700 700 700 700 700 700 700 700 700 700
				700 700 700 700 700 700 700 700 700 700 700 700 700 700 700 700 700 700
				700 700 700 700 700 700 700 700 700 700 700 700 700 700 700 700 700 700
				700 700 700 700 700 700 700 700 700 700 700 700 700 700 700 700 700 700
				700 700 700 700 700 700 700 700 700 700 700 700 700 700 700 700 700 700
				700 700 700 700 700 700 700 700 700 700 700 700 700 700 700 700 700 700
				700 700 700 700 700 700 700 700 700 700 700 700 700 700 700 700 700 700
				700 700 700 700 700 700 700 700 700 700 700 700 700 700 700 700 700 700
				700 700 700 700 700 700 700 700 700 700 700 700 700 700 700 700 700 700
				700 700 700 700 700 700 700 700 700 700 700 700 700 700 700 700 700 700
				400 400 400>;

			PS_Config_Lmt_FW_CC_P = <
				65535 113 110 110 112 65535 65535 65535 65535 65535 65535 65535 65535 117 116 116 117 65535
				119 116 113 113 113 115 115 115 115 116 115 115 115 115 115 115 116 120
				116 113 112 110 110 110 110 110 110 117 116 116 116 116 116 117 119 121
				116 113 112 112 112 112 112 113 113 116 115 115 115 115 115 115 116 119
				116 113 112 112 112 112 112 112 112 117 116 116 115 116 115 115 116 119
				117 115 113 113 113 115 113 115 115 115 113 113 113 113 113 113 115 117
				116 112 110 110 110 110 110 110 112 119 116 116 116 116 116 116 117 121
				116 113 112 112 112 112 113 113 113 116 115 115 115 115 115 115 115 117
				115 112 112 112 112 112 112 112 112 117 115 115 115 115 115 115 115 117
				117 115 113 113 113 113 115 115 115 116 113 115 113 113 113 113 113 116
				115 112 110 110 110 110 112 112 112 119 116 116 115 115 115 115 115 119
				115 112 112 112 112 112 112 113 112 120 115 115 113 113 115 113 113 116
				115 112 112 112 112 112 112 113 112 121 116 115 115 115 113 113 115 117
				117 115 115 115 115 115 115 117 115 120 116 113 113 112 113 112 112 115
				113 110 110 110 110 112 112 115 112 123 117 116 116 116 115 116 116 117
				115 113 113 113 113 113 115 116 113 121 117 115 115 113 115 113 113 115
				115 113 112 112 112 113 113 115 113 123 116 115 115 115 113 115 115 116
				116 115 115 115 115 115 115 116 115 120 113 113 113 112 112 112 112 113
				113 112 112 112 112 112 112 113 112 123 117 116 115 115 115 115 115 117
				115 113 113 113 113 113 113 115 115 121 115 115 113 113 113 113 113 115
				115 112 112 112 112 113 113 113 113 121 115 115 115 113 113 113 113 115
				116 115 115 115 115 116 116 116 115 121 113 113 113 112 112 112 112 113
				113 112 112 112 112 113 113 113 112 124 116 116 116 115 115 115 115 117
				115 113 113 113 113 115 115 116 113 121 115 115 113 112 112 113 112 115
				115 113 112 113 113 113 115 115 113 121 115 115 113 113 113 112 112 115
				116 115 115 115 115 116 116 117 115 117 115 113 113 112 110 112 110 113
				113 112 112 112 112 113 113 115 112 117 117 116 116 115 113 113 115 116
				116 113 115 113 113 116 116 117 115 112 116 113 115 112 112 112 112 113
				115 113 113 113 113 115 115 116 113 113 116 115 115 113 113 112 113 115
				116 115 115 115 115 117 116 117 115 112 115 113 113 112 112 112 112 113
				113 112 112 112 112 113 113 115 112 115 117 116 116 115 113 113 115 116
				116 115 115 115 115 116 116 117 115 112 115 115 113 112 112 112 112 113
				115 113 113 113 113 115 116 117 113 113 116 115 113 113 112 112 113 113
				117 115 116 116 116 117 119 119 116 110 115 115 113 112 112 110 110 112
				113 113 113 113 113 115 116 116 113 115 119 119 116 115 115 113 115 115
				113 112 112 112 112 115 116 116 113 110 116 116 115 112 110 110 110 110
				38 38 38>;

			PS_Config_Lmt_FW_CC_N = <
				0 51 50 50 50 0 0 0 0 0 0 0 0 53 52 52 53 0
				53 52 51 51 51 51 51 51 51 52 51 51 51 51 51 51 52 54
				52 51 50 50 50 50 50 50 50 53 52 52 52 52 52 53 53 55
				52 51 50 50 50 50 50 51 51 52 51 51 51 51 51 51 52 53
				52 51 50 50 50 50 50 50 50 53 52 52 51 52 51 51 52 53
				53 51 51 51 51 51 51 51 51 51 51 51 51 51 51 51 51 53
				52 50 50 50 50 50 50 50 50 53 52 52 52 52 52 52 53 55
				52 51 50 50 50 50 51 51 51 52 51 51 51 51 51 51 51 53
				51 50 50 50 50 50 50 50 50 53 51 51 51 51 51 51 51 53
				53 51 51 51 51 51 51 51 51 52 51 51 51 51 51 51 51 52
				51 50 50 50 50 50 50 50 50 53 52 52 51 51 51 51 51 53
				51 50 50 50 50 50 50 51 50 54 51 51 51 51 51 51 51 52
				51 50 50 50 50 50 50 51 50 55 52 51 51 51 51 51 51 53
				53 51 51 51 51 51 51 53 51 54 52 51 51 50 51 50 50 51
				51 50 50 50 50 50 50 51 50 55 53 52 52 52 51 52 52 53
				51 51 51 51 51 51 51 52 51 55 53 51 51 51 51 51 51 51
				51 51 50 50 50 51 51 51 51 55 52 51 51 51 51 51 51 52
				52 51 51 51 51 51 51 52 51 54 51 51 51 50 50 50 50 51
				51 50 50 50 50 50 50 51 50 55 53 52 51 51 51 51 51 53
				51 51 51 51 51 51 51 51 51 55 51 51 51 51 51 51 51 51
				51 50 50 50 50 51 51 51 51 55 51 51 51 51 51 51 51 51
				52 51 51 51 51 52 52 52 51 55 51 51 51 50 50 50 50 51
				51 50 50 50 50 51 51 51 50 56 52 52 52 51 51 51 51 53
				51 51 51 51 51 51 51 52 51 55 51 51 51 50 50 51 50 51
				51 51 50 51 51 51 51 51 51 55 51 51 51 51 51 50 50 51
				52 51 51 51 51 52 52 53 51 53 51 51 51 50 50 50 50 51
				51 50 50 50 50 51 51 51 50 53 53 52 52 51 51 51 51 52
				52 51 51 51 51 52 52 53 51 50 52 51 51 50 50 50 50 51
				51 51 51 51 51 51 51 52 51 51 52 51 51 51 51 50 51 51
				52 51 51 51 51 53 52 53 51 50 51 51 51 50 50 50 50 51
				51 50 50 50 50 51 51 51 50 51 53 52 52 51 51 51 51 52
				52 51 51 51 51 52 52 53 51 50 51 51 51 50 50 50 50 51
				51 51 51 51 51 51 52 53 51 51 52 51 51 51 50 50 51 51
				53 51 52 52 52 53 53 53 52 50 51 51 51 50 50 50 50 50
				51 51 51 51 51 51 52 52 51 51 53 53 52 51 51 51 51 51
				51 50 50 50 50 51 52 52 51 50 52 52 51 50 50 50 50 50
				9 9 9>;

			PS_Config_Lmt_FW_CC_I_P = <
				25 25 25 25 25 25 25 25 25 25 25 25 25 25 25 25 25 25
				25 25 25>;

			PS_Config_Lmt_FW_CC_I_N = <
				0 0 0 0 0 0 0 0 0 0 0 0 0 0 0 0 0 0
				0 0 0>;

			PS_Config_Lmt_FW_CC_Q_P = <
				25 25 25 25 25 25 25 25 25 25 25 25 25 25 25 25 25 25
				25 25 25>;

			PS_Config_Lmt_FW_CC_Q_N = <
				0 0 0 0 0 0 0 0 0 0 0 0 0 0 0 0 0 0
				0 0 0>;

			PS_Config_Lmt_FW_Diff_P = <
				65535 50 50 50 50 65535 65535 65535 65535 65535 65535 65535 50 50 50 50 50 65535
				50 50 50 50 50 50 50 50 50 50 50 50 50 50 50 50 50 50
				50 50 50 50 50 50 50 50 50 50 50 50 50 50 50 50 50 50
				50 50 50 50 50 50 50 50 50 50 50 50 50 50 50 50 50 50
				50 50 50 50 50 50 50 50 50 50 50 50 50 50 50 50 50 50
				50 50 50 50 50 50 50 50 50 50 50 50 50 50 50 50 50 50
				50 50 50 50 50 50 50 50 50 50 50 50 50 50 50 50 50 50
				50 50 50 50 50 50 50 50 50 50 50 50 50 50 50 50 50 50
				50 50 50 50 50 50 50 50 50 50 50 50 50 50 50 50 50 50
				50 50 50 50 50 50 50 50 50 50 50 50 50 50 50 50 50 50
				50 50 50 50 50 50 50 50 50 50 50 50 50 50 50 50 50 50
				50 50 50 50 50 50 50 50 50 50 50 50 50 50 50 50 50 50
				50 50 50 50 50 50 50 50 50 50 50 50 50 50 50 50 50 50
				50 50 50 50 50 50 50 50 50 50 50 50 50 50 50 50 50 50
				50 50 50 50 50 50 50 50 50 50 50 50 50 50 50 50 50 50
				50 50 50 50 50 50 50 50 50 50 50 50 50 50 50 50 50 50
				50 50 50 50 50 50 50 50 50 50 50 50 50 50 50 50 50 50
				50 50 50 50 50 50 50 50 50 50 50 50 50 50 50 50 50 50
				50 50 50 50 50 50 50 50 50 50 50 50 50 50 50 50 50 50
				50 50 50 50 50 50 50 50 50 50 50 50 50 50 50 50 50 50
				50 50 50 50 50 50 50 50 50 50 50 50 50 50 50 50 50 50
				50 50 50 50 50 50 50 50 50 50 50 50 50 50 50 50 50 50
				50 50 50 50 50 50 50 50 50 50 50 50 50 50 50 50 50 50
				50 50 50 50 50 50 50 50 50 50 50 50 50 50 50 50 50 50
				50 50 50 50 50 50 50 50 50 50 50 50 50 50 50 50 50 50
				50 50 50 50 50 50 50 50 50 50 50 50 50 50 50 50 50 50
				50 50 50 50 50 50 50 50 50 50 50 50 50 50 50 50 50 50
				50 50 50 50 50 50 50 50 50 50 50 50 50 50 50 50 50 50
				50 50 50 50 50 50 50 50 50 50 50 50 50 50 50 50 50 50
				50 50 50 50 50 50 50 50 50 50 50 50 50 50 50 50 50 50
				50 50 50 50 50 50 50 50 50 50 50 50 50 50 50 50 50 50
				50 50 50 50 50 50 50 50 50 50 50 50 50 50 50 50 50 50
				50 50 50 50 50 50 50 50 50 50 50 50 50 50 50 50 50 50
				50 50 50 50 50 50 50 50 50 50 50 50 50 50 50 50 50 50
				50 50 50 50 50 50 50 50 50 50 50 50 50 50 50 50 50 50
				50 50 50 50 50 50 50 50 50 50 50 50 50 50 50 50 50 50
				50 50 50>;

			PS_Config_Lmt_FW_Diff_N = <
				(-65535) (-50) (-50) (-50) (-50) (-65535) (-65535) (-65535) (-65535) (-65535) (-65535) (-65535) (-65535) (-50) (-50) (-50) (-50) (-65535)
				(-50) (-50) (-50) (-50) (-50) (-50) (-50) (-50) (-50) (-50) (-50) (-50) (-50) (-50) (-50) (-50) (-50) (-50)
				(-50) (-50) (-50) (-50) (-50) (-50) (-50) (-50) (-50) (-50) (-50) (-50) (-50) (-50) (-50) (-50) (-50) (-50)
				(-50) (-50) (-50) (-50) (-50) (-50) (-50) (-50) (-50) (-50) (-50) (-50) (-50) (-50) (-50) (-50) (-50) (-50)
				(-50) (-50) (-50) (-50) (-50) (-50) (-50) (-50) (-50) (-50) (-50) (-50) (-50) (-50) (-50) (-50) (-50) (-50)
				(-50) (-50) (-50) (-50) (-50) (-50) (-50) (-50) (-50) (-50) (-50) (-50) (-50) (-50) (-50) (-50) (-50) (-50)
				(-50) (-50) (-50) (-50) (-50) (-50) (-50) (-50) (-50) (-50) (-50) (-50) (-50) (-50) (-50) (-50) (-50) (-50)
				(-50) (-50) (-50) (-50) (-50) (-50) (-50) (-50) (-50) (-50) (-50) (-50) (-50) (-50) (-50) (-50) (-50) (-50)
				(-50) (-50) (-50) (-50) (-50) (-50) (-50) (-50) (-50) (-50) (-50) (-50) (-50) (-50) (-50) (-50) (-50) (-50)
				(-50) (-50) (-50) (-50) (-50) (-50) (-50) (-50) (-50) (-50) (-50) (-50) (-50) (-50) (-50) (-50) (-50) (-50)
				(-50) (-50) (-50) (-50) (-50) (-50) (-50) (-50) (-50) (-50) (-50) (-50) (-50) (-50) (-50) (-50) (-50) (-50)
				(-50) (-50) (-50) (-50) (-50) (-50) (-50) (-50) (-50) (-50) (-50) (-50) (-50) (-50) (-50) (-50) (-50) (-50)
				(-50) (-50) (-50) (-50) (-50) (-50) (-50) (-50) (-50) (-50) (-50) (-50) (-50) (-50) (-50) (-50) (-50) (-50)
				(-50) (-50) (-50) (-50) (-50) (-50) (-50) (-50) (-50) (-50) (-50) (-50) (-50) (-50) (-50) (-50) (-50) (-50)
				(-50) (-50) (-50) (-50) (-50) (-50) (-50) (-50) (-50) (-50) (-50) (-50) (-50) (-50) (-50) (-50) (-50) (-50)
				(-50) (-50) (-50) (-50) (-50) (-50) (-50) (-50) (-50) (-50) (-50) (-50) (-50) (-50) (-50) (-50) (-50) (-50)
				(-50) (-50) (-50) (-50) (-50) (-50) (-50) (-50) (-50) (-50) (-50) (-50) (-50) (-50) (-50) (-50) (-50) (-50)
				(-50) (-50) (-50) (-50) (-50) (-50) (-50) (-50) (-50) (-50) (-50) (-50) (-50) (-50) (-50) (-50) (-50) (-50)
				(-50) (-50) (-50) (-50) (-50) (-50) (-50) (-50) (-50) (-50) (-50) (-50) (-50) (-50) (-50) (-50) (-50) (-50)
				(-50) (-50) (-50) (-50) (-50) (-50) (-50) (-50) (-50) (-50) (-50) (-50) (-50) (-50) (-50) (-50) (-50) (-50)
				(-50) (-50) (-50) (-50) (-50) (-50) (-50) (-50) (-50) (-50) (-50) (-50) (-50) (-50) (-50) (-50) (-50) (-50)
				(-50) (-50) (-50) (-50) (-50) (-50) (-50) (-50) (-50) (-50) (-50) (-50) (-50) (-50) (-50) (-50) (-50) (-50)
				(-50) (-50) (-50) (-50) (-50) (-50) (-50) (-50) (-50) (-50) (-50) (-50) (-50) (-50) (-50) (-50) (-50) (-50)
				(-50) (-50) (-50) (-50) (-50) (-50) (-50) (-50) (-50) (-50) (-50) (-50) (-50) (-50) (-50) (-50) (-50) (-50)
				(-50) (-50) (-50) (-50) (-50) (-50) (-50) (-50) (-50) (-50) (-50) (-50) (-50) (-50) (-50) (-50) (-50) (-50)
				(-50) (-50) (-50) (-50) (-50) (-50) (-50) (-50) (-50) (-50) (-50) (-50) (-50) (-50) (-50) (-50) (-50) (-50)
				(-50) (-50) (-50) (-50) (-50) (-50) (-50) (-50) (-50) (-50) (-50) (-50) (-50) (-50) (-50) (-50) (-50) (-50)
				(-50) (-50) (-50) (-50) (-50) (-50) (-50) (-50) (-50) (-50) (-50) (-50) (-50) (-50) (-50) (-50) (-50) (-50)
				(-50) (-50) (-50) (-50) (-50) (-50) (-50) (-50) (-50) (-50) (-50) (-50) (-50) (-50) (-50) (-50) (-50) (-50)
				(-50) (-50) (-50) (-50) (-50) (-50) (-50) (-50) (-50) (-50) (-50) (-50) (-50) (-50) (-50) (-50) (-50) (-50)
				(-50) (-50) (-50) (-50) (-50) (-50) (-50) (-50) (-50) (-50) (-50) (-50) (-50) (-50) (-50) (-50) (-50) (-50)
				(-50) (-50) (-50) (-50) (-50) (-50) (-50) (-50) (-50) (-50) (-50) (-50) (-50) (-50) (-50) (-50) (-50) (-50)
				(-50) (-50) (-50) (-50) (-50) (-50) (-50) (-50) (-50) (-50) (-50) (-50) (-50) (-50) (-50) (-50) (-50) (-50)
				(-50) (-50) (-50) (-50) (-50) (-50) (-50) (-50) (-50) (-50) (-50) (-50) (-50) (-50) (-50) (-50) (-50) (-50)
				(-50) (-50) (-50) (-50) (-50) (-50) (-50) (-50) (-50) (-50) (-50) (-50) (-50) (-50) (-50) (-50) (-50) (-50)
				(-50) (-50) (-50) (-50) (-50) (-50) (-50) (-50) (-50) (-50) (-50) (-50) (-50) (-50) (-50) (-50) (-50) (-50)
				(-50) (-50) (-50)>;

			PS_Config_Diff_Test_Frame = <50>;
		};
	};
};
