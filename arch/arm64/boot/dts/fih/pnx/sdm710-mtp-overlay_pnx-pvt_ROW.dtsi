#include "sdm710-fih-info_pnx-pvt_ROW.dtsi"

/* Pinctrl */

/* PMIC */
#include "sdm670-charger_pnx-pvt.dtsi"

/* Touch */

/* Display */

/* Haptics */

/* ASIC Flash */

/* NFC */
#include "nfc-sec-evt.dtsi"

/* Audio */
#include "audio-alsa-evt.dtsi"

/* Gyro */

/* Hall sensor */

/* Switch */

/* Camera */
#include "../common/sdm670-fih-camera-sensor-mtp-evt.dtsi"/* MM-CCC-BringUpCameraSensorForEvt-20180511-00+ */

/* Fingerprint */

/* SD Card */

/* Wifi */

/* keypad */

/* USB */
#include "sdm670-usb_phx-evt.dtsi"
