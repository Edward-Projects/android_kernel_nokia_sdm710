&soc {
	fih_info {
		compatible = "fih_info";
		status = "ok";
		fih-info,devmodel = "PNX";
		fih-info,baseband = "2.0";
		fih-info,bandinfo = "G_850_900_1800^W_1_5_8^L_1_3_5_8_40_41";
		fih-info,hwmodel  = "PNXI";
		fih-info,simslot  = "2";
		fih-info,variant  = "0";
	};
};
