&qupv3_se9_i2c {
        status = "okay";
        pinctrl-names = "default", "sleep";
        pinctrl-0 = <&qupv3_se9_i2c_active>;
        pinctrl-1 = <&qupv3_se9_i2c_sleep>;
        qcom,clk-freq-out = <400000>;
        qcom,clk-freq-in  = <19200000>;
        
        himax-ts@48 {
                compatible = "himax,hxcommon";
                reg = <0x48>;
                interrupt-parent = <&tlmm>;
                interrupts = <125 0x2>;
                himax,rst-gpio = <&tlmm 99 0x00>;
                himax,irq-gpio = <&tlmm 125 0x00>;
                himax,display-coords =  <0 1080 0 2246>;
		himax,panel-coords = <0 1080 0 2246>;
        };
};
