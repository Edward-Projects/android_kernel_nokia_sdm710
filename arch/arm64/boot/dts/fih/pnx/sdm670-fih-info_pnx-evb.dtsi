&soc {
	fih_info {
		compatible = "fih_info";
		status = "ok";
		fih-info,devmodel = "PNX";
		fih-info,baseband = "EVB";
		fih-info,bandinfo = "G_^W_^C_^T_^L_";
		fih-info,hwmodel  = "PNX";
		fih-info,simslot  = "2";
		fih-info,variant  = "0";
	};
};
