
qcom,jd_ishen_3400mah_pnx {
	qcom, = <24>;
	/* #3806547_FIH_HE376_3500mAh_averaged_MasterSlave_Jan22nd2019*/
	fih,batt-manufacturer = "JD-LiShen";
	qcom,fastchg-current-ma = <3400>;
	qcom,max-voltage-uv = <4400000>;
	qcom,nom-batt-capacity-mah = <3500>;
	qcom,batt-id-kohm = <51>;
	qcom,battery-beta = <3380>;
	qcom,fg-cc-cv-threshold-mv = <4390>;
	qcom,jeita-fcc-ranges = <0	159	1000000
				 160	439	3400000
				 440	550	1000000>;
	qcom,jeita-fv-ranges = <0	439	4400000
				440	550	4150000>;
	fih,jeita-hysteresis = <9>;
	fih,warm-recharge-voltage-uv = <4050000>;
	qcom,step-chg-ranges = <0	3000000	250000
				3010000	3200000	1400000
				3210000	4400000	3400000>;
	fih,step-chg-hysteresis = <0>;
	qcom,battery-type = "jd_ishen_3400mah_pnx";
	qcom,checksum = <0x2436>;
	qcom,gui-version = "PM660GUI - 0.0.0.45";
	qcom,fg-profile-data = [
		 A3 1E CB 06
		 F6 02 69 F5
		 D8 1C 11 02
		 7E 0D EC 0A
		 EA 17 D5 23
		 48 44 79 5A
		 69 00 00 00
		 10 00 00 00
		 00 00 90 B2
		 A2 CD 62 B3
		 24 00 08 00
		 8D DB 44 E5
		 1B FC 2F 01
		 63 DA B2 12
		 05 FD 2B 33
		 1F 06 09 20
		 27 00 14 00
		 61 1F 47 FC
		 E5 03 E5 06
		 BD 1C 2F 03
		 C4 15 74 12
		 7B 18 25 2A
		 5E 4D 3D 62
		 64 00 00 00
		 0C 00 00 00
		 00 00 C8 D5
		 A7 CA 57 AD
		 1E 00 00 00
		 B4 E3 44 E5
		 6F FD B9 F2
		 C2 EC BA 03
		 85 FB E0 1A
		 B7 33 CC FF
		 07 10 00 00
		 CB 0D 66 46
		 1E 00 40 00
		 92 01 0A FA
		 FF 00 00 00
		 00 00 00 00
		 00 00 00 00
		 00 00 00 00
		 00 00 00 00
		 00 00 00 00
		 00 00 00 00
		 00 00 00 00
		 00 00 00 00
		 00 00 00 00
		 00 00 00 00
		 00 00 00 00
		 00 00 00 00
		 00 00 00 00
		 00 00 00 00
		 00 00 00 00
		 00 00 00 00
		 00 00 00 00
		 00 00 00 00
	];
};
