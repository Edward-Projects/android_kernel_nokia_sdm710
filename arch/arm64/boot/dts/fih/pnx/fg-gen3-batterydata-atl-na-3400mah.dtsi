
qcom,atl_na_3400mah_pnx {
	qcom, = <24>;
	/* #3465557_cos_3400mAh_averaged_MasterSlave_Jun6th2018*/
	fih,batt-manufacturer = "ATL-NA";
	qcom,fastchg-current-ma = <3400>;
	qcom,max-voltage-uv = <4400000>;
	qcom,nom-batt-capacity-mah = <3400>;
	qcom,batt-id-kohm = <130>;
	qcom,battery-beta = <3435>;
	qcom,fg-cc-cv-threshold-mv = <4390>;
	qcom,jeita-fcc-ranges = <0	159	1000000
				 160	439	3400000
				 440	550	1000000>;
	qcom,jeita-fv-ranges = <0	439	4400000
				440	550	4150000>;
	fih,jeita-hysteresis = <9>;
	fih,warm-recharge-voltage-uv = <4050000>;
	qcom,step-chg-ranges = <0	3000000	250000
				3010000	3200000	1400000
				3210000	4400000	3400000>;
	fih,step-chg-hysteresis = <0>;
	qcom,battery-type = "atl_na_3400mah_pnx";
	qcom,checksum = <0x9EF8>;
	qcom,gui-version = "PM660GUI - 0.0.0.45";
	qcom,fg-profile-data = [
		 D1 1E 0B FD
		 4D 03 FB F4
		 89 1C F1 02
		 F8 15 47 12
		 29 17 1C 2A
		 F8 4D B2 5A
		 63 00 00 00
		 10 00 00 00
		 00 00 5B CC
		 4A C4 E7 D2
		 2B 00 08 00
		 29 00 83 E4
		 6D 05 43 FB
		 82 04 50 12
		 B7 BA F4 22
		 47 06 09 20
		 27 00 14 00
		 55 1F 4D FC
		 D4 03 F8 06
		 AE 1C 4B 03
		 A2 15 9C 12
		 0D 18 E9 23
		 03 44 D1 5A
		 63 00 00 00
		 0F 00 00 00
		 00 00 19 CC
		 08 D2 61 CD
		 1D 00 00 00
		 36 EA 83 E4
		 62 06 E6 00
		 A2 06 44 02
		 29 FD 58 1B
		 B7 33 CC FF
		 07 10 00 00
		 28 0E 66 46
		 1D 00 40 00
		 84 01 0A FA
		 FF 00 00 00
		 00 00 00 00
		 00 00 00 00
		 00 00 00 00
		 00 00 00 00
		 00 00 00 00
		 00 00 00 00
		 00 00 00 00
		 00 00 00 00
		 00 00 00 00
		 00 00 00 00
		 00 00 00 00
		 00 00 00 00
		 00 00 00 00
		 00 00 00 00
		 00 00 00 00
		 00 00 00 00
		 00 00 00 00
		 00 00 00 00
	];
};
