## drivers/fih/Kconfig
```kconfig
#
# fih driver
#

menu "fih driver"

config FIH
	bool "fih"
	default n
	help
	  support fih

config FIH_APR
	bool "fih apr"
	depends on FIH
	default n
	help
	  support fih apr virtual file

config FIH_INFO
	bool "fih info"
	depends on FIH
	default n
	help
	  support fih info virtual file

config FIH_DDR
	bool "fih ddr"
	depends on FIH
	default n
	help
	  support fih ddr virtual file

config FIH_EMMC
	bool "fih emmc"
	default y
	help
	  support fih emmc function

config FIH_KEY
	bool "fih key"
	depends on FIH
	default n
	help
	  support fih key logging

config FIH_MFD
	bool "fih mfd"
	depends on FIH
	default n
	help
	  support fih mfd virtual file

config FIH_NV
	bool "fih nv"
	depends on FIH
	default n
	help
	  support fih nv function

config FIH_CDA
	bool "fih cda"
	depends on FIH
	default n
	help
	  support fih cda virtual file

config FIH_SEB
	bool "fih seb"
	depends on FIH
	default n
	help
	  support fih seb virtual file

config FIH_LOG
	bool "fih log"
	depends on FIH
	default n
	help
	  support fih log virtual file

config FIH_MFR
	bool "fih mfr"
	depends on FIH
	default n
	help
	  support fih mfr virtual file

config FIH_TOUCH
	bool "fih touch"
	depends on FIH
	default y
	help
	  support fih touch virtual file

config FIH_CPU_USAGE
	bool "FIH cpu usage information"
	depends on FIH
	default n
	help
	  support fih cpu usage information

config FIH_DLOAD
	bool "fih download mode by bset enable"
	default n
	help
	  support fih download mode by bset enable

config FIH_FVER
	bool "fih fver"
	depends on FIH
	default n
	help
	  support fih fver virtual file

config FIH_RESUME_PERFORMANCE_LOG
	bool "FIH LOG about resume performance"
	default n
	help
	  Enable resume performance log

config FIH_HALL_SENSOR
	bool "fih hall sensor"
	depends on FIH
	default n
	help
	  support fih cda virtual file

config FIH_BATTERY
	bool "fih battery"
	depends on FIH
	default n
	help
	  support fih battery

config FIH_USB
	bool "FIH USB Driver"
	depends on FIH
	default n
	help
	  support FIH USB Driver

config FIH_CPU
	bool "fih cpu"
	depends on FIH
	default n
	help
	  support fih cpu virtual file

config FIH_SUSPEND_RESUME_LOG
	bool "FIH LOG about suspend/resume"
	depends on FIH
	default n
	help
	  Enable more log for suspend/resume debugging.

config FIH_DUMP_WAKELOCK
	bool "Show wakelock info after screen off."
	depends on FIH
	default n
	help
	  Show active wakelock info after screen off.

config FIH_RPMH_MASTER_STATS
	bool "Show rpmh master stats."
	depends on FIH
	default n
	help
	  Show rpmh master stats when device resume from suspend.

config FIH_LCM
	bool "fih Lcm"
	depends on FIH
	default n
	help
	  support fih Lcm

config FIH_RECAL_STATUS
	bool "fih recal status"
	default y
	help
	  support fih recal status function

endmenu
```

## drivers/input/fingerprint/Kconfig
```kconfig
#
# fingerprint driver
#

menu "Fingerprint Driver"

config GOODIX_FINGERPRINT
    bool "generic goodix fingerprint driver"
    default n
    help
      add support for goodix fingerprint driver

config EGIS_FINGERPRINT
    bool "generic egis fingerprint driver"
    default n
    help
      add support for egis fingerprint driver

endmenu
```
